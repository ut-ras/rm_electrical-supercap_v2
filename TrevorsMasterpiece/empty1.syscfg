/**
 *
 * @cliArgs --device "MSPM0G350X" --part "Default" --package "VSSOP-32(DGS32)" --product "mspm0_sdk@2.11.00.07"
 * @versions {"tool":"1.28.2+4845"}
 */

/**
 * Import the modules used in this configuration.
 */
const ADC12       = scripting.addModule("/ti/driverlib/ADC12", {}, false);
const ADC121      = ADC12.addInstance();
const ADC122      = ADC12.addInstance();
const Board       = scripting.addModule("/ti/driverlib/Board");
const GPIO        = scripting.addModule("/ti/driverlib/GPIO", {}, false);
const GPIO1       = GPIO.addInstance();
const PWM         = scripting.addModule("/ti/driverlib/PWM", {}, false);
const PWM1        = PWM.addInstance();
const SYSCTL      = scripting.addModule("/ti/driverlib/SYSCTL");
const TIMERFault  = scripting.addModule("/ti/driverlib/TIMERFault", {}, false);
const TIMERFault1 = TIMERFault.addInstance();

/**
 * Write custom configuration values to the imported modules.
 */
ADC121.$name                 = "ADC12_0";
ADC121.samplingOperationMode = "sequence";
ADC121.endAdd                = 1;
ADC121.repeatMode            = true;
ADC121.disChan12             = true;
ADC121.trigSrc               = "DL_ADC12_TRIG_SRC_EVENT";
ADC121.enabledInterrupts     = ["DL_ADC12_INTERRUPT_MEM1_RESULT_LOADED"];
ADC121.subChanID             = 1;
ADC121.adcPin0Config.$name   = "ti_driverlib_gpio_GPIOPinGeneric0";

ADC122.$name                 = "ADC12_1";
ADC122.samplingOperationMode = "sequence";
ADC122.endAdd                = 1;
ADC122.repeatMode            = true;
ADC122.trigSrc               = "DL_ADC12_TRIG_SRC_EVENT";
ADC122.subChanID             = 2;
ADC122.adcPin0Config.$name   = "ti_driverlib_gpio_GPIOPinGeneric1";


GPIO1.$name                                 = "GPIO_GRP_0";
GPIO1.associatedPins[0].$name               = "PIN_0";
GPIO1.associatedPins[0].assignedPort        = "PORTA";
GPIO1.associatedPins[0].assignedPortSegment = "Lower";
GPIO1.associatedPins[0].assignedPin         = "0";

PWM1.$name                       = "PWM_0";
PWM1.timerCount                  = 133;
PWM1.ccIndexCmpl                 = [0,1];
PWM1.ccIndex                     = [0,1,2];
PWM1.deadBandEn                  = true;
PWM1.dbRiseDelayTimerCount       = 3;
PWM1.dbFallDelayTimerCount       = 3;
PWM1.faultHandlerEn              = true;
PWM1.faultSource                 = ["0"];
PWM1.faultTriggerIn              = "TFIM_ENABLED";
PWM1.faultConditionDuration      = "FL_LATCH_SW_CLR";
PWM1.faultInputEn                = "FIEN_ENABLED";
PWM1.faultTimerCountEntry        = "FAULT_ENTRY_CTR_SUSP_COUNT";
PWM1.faultChannel0BehaviorEntry  = "LOW";
PWM1.faultChannel0BehaviorExit   = "LOW";
PWM1.faultChannel1BehaviorEntry  = "LOW";
PWM1.faultChannel1BehaviorExit   = "LOW";
PWM1.event1PublisherChannel      = 1;
PWM1.event2PublisherChannel      = 2;
PWM1.event1ControllerInterruptEn = ["CC2_UP_EVENT"];
PWM1.event2ControllerInterruptEn = ["CC2_UP_EVENT"];
PWM1.PWM_CHANNEL_0.$name         = "ti_driverlib_pwm_PWMTimerCC0";
PWM1.PWM_CHANNEL_0.dutyCycle     = 70;
PWM1.PWM_CHANNEL_1.$name         = "ti_driverlib_pwm_PWMTimerCC1";
PWM1.PWM_CHANNEL_1.dutyCycle     = 40;
PWM1.PWM_CHANNEL_1.ccValue       = 53;
PWM1.ccp0PinConfig.$name         = "ti_driverlib_gpio_GPIOPinGeneric2";
PWM1.ccp1PinConfig.$name         = "ti_driverlib_gpio_GPIOPinGeneric3";
PWM1.ccp0Pin_cmplConfig.$name    = "ti_driverlib_gpio_GPIOPinGeneric4";
PWM1.ccp1Pin_cmplConfig.$name    = "ti_driverlib_gpio_GPIOPinGeneric5";
PWM1.PWM_CHANNEL_2.$name         = "ti_driverlib_pwm_PWMTimerCC2";
PWM1.PWM_CHANNEL_2.ccValue       = 0;
PWM1.ccp2PinConfig.$name         = "ti_driverlib_gpio_GPIOPinGeneric6";

SYSCTL.forceDefaultClkConfig = true;

TIMERFault1.$name                 = "FAULT_0";
PWM1.associatedFault              = TIMERFault1;
TIMERFault1.enabledFaults         = ["0"];
TIMERFault1.faultPin0.$assign     = "PA26";
TIMERFault1.faultPin0Config.$name = "ti_driverlib_gpio_GPIOPinGeneric7";

/**
 * Pinmux solution for unlocked pins/peripherals. This ensures that minor changes to the automatic solver in a future
 * version of the tool will not impact the pinmux you originally saw.  These lines can be completely deleted in order to
 * re-solve from scratch.
 */
ADC121.peripheral.$suggestSolution            = "ADC1";
ADC121.peripheral.adcPin0.$suggestSolution    = "PA15";
ADC122.peripheral.$suggestSolution            = "ADC0";
ADC122.peripheral.adcPin0.$suggestSolution    = "PA27";
Board.peripheral.$suggestSolution             = "DEBUGSS";
Board.peripheral.swclkPin.$suggestSolution    = "PA20";
Board.peripheral.swdioPin.$suggestSolution    = "PA19";
GPIO1.associatedPins[0].pin.$suggestSolution  = "PA0";
PWM1.peripheral.$suggestSolution              = "TIMA0";
PWM1.peripheral.ccp0Pin.$suggestSolution      = "PA21";
PWM1.peripheral.ccp0Pin_cmpl.$suggestSolution = "PA22";
PWM1.peripheral.ccp1Pin.$suggestSolution      = "PA1";
PWM1.peripheral.ccp1Pin_cmpl.$suggestSolution = "PA25";
PWM1.peripheral.ccp2Pin.$suggestSolution      = "PA10";
SYSCTL.peripheral.$suggestSolution            = "SYSCTL";
